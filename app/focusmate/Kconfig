## app/focusmate/Kconfig
```kconfig
#
# For a description of the syntax of this configuration file,
# see the file kconfig-language.txt in the NuttX tools repository.
#

config LVX_USE_DEMO_FOCUSMATE
	bool "FocusMate - AI 桌面专注伙伴"
	default n
	depends on GRAPHICS_LVGL
	---help---
		FocusMate: an AI-powered desktop focus companion.
		Splits a goal into structured focus stages (focus-planner),
		runs a focus state machine, and reacts to phone presence
		(active pause/resume). M3 skeleton: state machine + CLI + UI.

if LVX_USE_DEMO_FOCUSMATE

config FOCUSMATE_DATA_DIR
	string "FocusMate data directory"
	default "/data/focusmate"

config FOCUSMATE_SKILL_DIR
	string "FocusMate ai_agent skill directory"
	default "/data/ai_agent/skills"
	---help---
		Must match ai_agent's AGENT_SKILLS_DIR (<data dir>/skills/);
		otherwise the skill lands somewhere the agent neither lists in
		its prompt nor allows read_file to open.

config FOCUSMATE_LCD_DEVPATH
	string "FocusMate LCD device path"
	default "/dev/lcd0"

config FOCUSMATE_INPUT_DEVPATH
	string "FocusMate touchscreen device path"
	default "/dev/input0"

config FOCUSMATE_ENABLE_UI
	bool "Enable LVGL UI"
	default y
	depends on LV_USE_NUTTX

config FOCUSMATE_HOME_MASK
        hex "Verified Home button bit mask (0 disables)"
        default 0

config FOCUSMATE_TALK_MASK
        hex "Verified Talk button bit mask (0 disables)"
        default 0

config FOCUSMATE_PHONE_GPIO
        bool "Use PA41 active-low phone dock switch (SF32LB52 QSPI board)"
        default n
        depends on ARCH_CHIP_SF32LB52 && DEV_GPIO
        help
                Requires the board patch registering /dev/phone0 as input pull-up.
                Header pin 5 is PA41; pin 6 is GND. Mock phone events are disabled.

config FOCUSMATE_PHONE_DEVPATH
        string "Phone presence GPIO device"
        default "/dev/phone0"
        depends on FOCUSMATE_PHONE_GPIO

endif
```
